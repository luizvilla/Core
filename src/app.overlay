/**
 * old16 (Ownverter per-leg frequency test) on a Twist 1.4.2, same timers:
 *   LEG1 (TIMA): common default-frequency, 200 kHz
 *   LEG2 (TIMC): leg-frequency 100 kHz
 *   LEG3 (TIME, PC8 / PC9, Spin 10 / 11, added): leg-frequency 50 kHz
 * min-frequency is 50 kHz on the Twist 1.4.2 already.
 */
&leg2 {
    leg-frequency = <100000>;
};

&powershield {
    leg3: leg3 {
        leg-name = "LEG3";
        pwms = <&pwme 1 0>, <&pwme 2 0>;
        pwm-pin-num = <10 11>;
        default-adc = "UNKNOWN_ADC";
        default-adc-decim = <1>;
        default-edge-trigger = "EdgeTrigger_up";
        default-dead-time = <100 100>;
        default-modulation = "UpDwn";
        default-phase-shift = <0>;
        leg-frequency = <50000>;
        status = "okay";
    };
};
