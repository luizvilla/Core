## zephyr/boards/shields/uSolarVerter/Kconfig.shield
```kconfig
# Copyright (c) 2023 OwnTech
# SPDX-License-Identifier: LGPL-2.1

config SHIELD_USOLARVERTER
	def_bool $(shields_list_contains,uSolarVerter_v0_9_0) || \
			 $(shields_list_contains,uSolarVerter)

config SHIELD_USOLARVERTER_V0_9_0
	def_bool $(shields_list_contains,uSolarVerter_v0_9_0)

config HAS_POWER_SHIELD
	default y
	bool "uSolarVerter is a Power Shield"
```
