## zephyr/boards/shields/powerverter/Kconfig.shield
```kconfig
# Copyright (c) 2023 OwnTech
# SPDX-License-Identifier: LGPL-2.1

config SHIELD_POWERVERTER
	def_bool $(shields_list_contains,powerverter_v0_9_0) || \
			 $(shields_list_contains,powerverter)
```

## zephyr/dts/bindings/safety-config.yaml
```yaml
description: |
  Safety API configuration of the application (ADR 0009). Declared in app.overlay, at most once:

    / {
        safety-config {
            compatible = "safety-config";
            safety-mode = "development";
        };
    };

compatible: "safety-config"

properties:
  safety-mode:
    type: string
    required: false
    default: "production"
    enum:
      - "production"
      - "development"
    description: |
      "production" (default, also when the node is absent): every protection is on and can only be tightened.
      "development": for bring-up on a bench only. safety.disarm() compiles (it leaves the comparator and
      ADC-watchdog trips unarmed), the software thresholds may be loosened beyond the devicetree limit,
      disableSafetyApi() stops the software check, and CONFIG_OWNTECH_SAFETY_RUNTIME_SELFTEST may be turned off.
      CPU supervision (watchdog, fatal-error handler, system fault) stays on. The firmware prints a banner at
      boot and reports the mode (safety.isDevelopmentMode(), the boot line, the protection manifest).
```

## zephyr/dts/bindings/safety-outputs.yaml
```yaml
description: |
  Safe outputs (ADR 0009): GPIOs that the firmware drives to their safe level on any trip, such as a grid relay or
  a gate-driver enable. After a watchdog reset the MCU pins float, so the board itself must hold each one at its
  safe level (pull resistor); declare it with reset-state-safe once checked on the schematic.

compatible: "safety-outputs"

child-binding:
  description: One safe output.
  properties:
    gpios:
      type: phandle-array
      required: true
      description: The pin, usually on the Spin header connector (<&spin_header PIN FLAGS>).
    output-name:
      type: string
      required: false
      description: Name shown in the boot line and the protection table (default the node name).
    safe-level:
      type: int
      required: true
      enum: [0, 1]
      description: Pin level of the safe state (e.g. 0 for a relay that opens when its command is low).
    reset-state-safe:
      type: boolean
      description: The board holds this pin at its safe level while the MCU resets (checked on the schematic).
```

## zephyr/dts/bindings/safety-thresholds.yaml
```yaml
description: List of thresholds for the measurement of the sensors connected to ADCs and acquired by OwnTech Data Acquisition module

compatible: "safety-thresholds"

properties:
  sensor-name:
    type: string
    required: true
    description: Name under which the channel will be referred to in the data Acquisition module

  threshold-name:
    type: string
    required: true
    description: Name under which the threshold will be referred to in the user code

  threshold-high:
    type: int
    required: true
    description: The value of the high threshold above which the program will return an error code

  threshold-low:
    type: int
    required: true
    description: The value of the low threshold below which the program will return an error code

  protection:
    type: string
    required: false
    default: "hardware"
    enum:
      - "hardware"
      - "software"
    description: |
      ADR 0009. "hardware" (default): both bounds must get a hardware path (comparator or ADC watchdog to an HRTIM
      fault input), assigned by the build. If the board cannot provide one, the build fails unless `exception`
      states why software protection is acceptable. "software": the limit is only checked by the Safety API's
      polling (for quantities that are not a hazard, e.g. a measurement range check).

  exception:
    type: string
    required: false
    description: |
      Why this limit may fall back to the software path where no hardware path exists on this board (for example
      "legacy board: sensor routed to a pin no comparator or free ADC watchdog reaches"). Shown in the protection
      table. Without it, a hardware limit with no hardware path is a build error.

  comparator-bound:
    type: string
    required: false
    default: "high"
    enum:
      - "high"
      - "low"
    description: |
      Which bound the comparator watches when the sensor pin reaches one (a comparator trips in one direction
      only). The other bound gets an ADC-watchdog window if one is free.

  priority:
    type: int
    required: false
    description: |
      Order in which the build serves limits when hardware channels are scarce: lower first. Default 10 for
      currents (sensor names starting with I) and 20 otherwise. Give the hazard that matters most on this board
      the lowest number (e.g. the DC bus overvoltage).
```

## zephyr/dts/bindings/shield-position-abz.yaml
```yaml
description: Incremental encoder wiring and default configuration exposed by a shield

compatible: "shield-position-abz"

properties:
  position-sensor-name:
    type: string
    required: true
    description: Name under which the position sensor is referred to in user code.

  motor:
    type: phandle
    required: false
    description: Optional reference to the default motor configuration node.

  direction-sign:
    type: int
    required: false
    description: Direction convention used by this position sensor, typically 1 or -1.

  electrical-offset:
    type: int
    required: false
    description: Electrical offset for this position sensor, stored as an IEEE754 float32 bit pattern.

  timer:
    type: phandle
    required: true
    description: Timer instance used in incremental encoder mode.

  counts-per-revolution:
    type: int
    required: false
    description: Counts per revolution of this incremental encoder.

  index-present:
    type: int
    required: false
    description: Set to 1 when the encoder index signal is wired and should reset the counter, or 0 to keep AB quadrature without index reset.

  index-polarity:
    type: string
    required: false
    enum:
      - "NONINVERTED"
      - "INVERTED"
    description: Active polarity of the encoder index input.

  index-configuration:
    type: string
    required: false
    enum:
      - "A_LOW_B_LOW"
      - "A_LOW_B_HIGH"
      - "A_HIGH_B_LOW"
      - "A_HIGH_B_HIGH"
    description: AB phase state required for the index signal to reset the counter.
```

## zephyr/modules/owntech_safety_api/zephyr/Kconfig
```kconfig
config OWNTECH_SAFETY_API
	bool "Enable OwnTech safety measures to protect the board"
	default y
	depends on OWNTECH_SHIELD_API

config OWNTECH_SAFETY_SUPERVISION
	bool
	default y if OWNTECH_HRTIM_DRIVER
	help
		CPU supervision (ADR 0009): independent watchdog, fatal-error
		handler and HRTIM system fault. It has no prompt on purpose:
		user configuration cannot turn it off. It does not need a shield.

config OWNTECH_SAFETY_REPEAT_CLEAR_MS
	int "Time after a clear during which a new fault requires a reboot (ms)"
	default 10000
	range 100 600000
	depends on OWNTECH_SAFETY_SUPERVISION
	help
		ADR 0009: clearFault() after a second fault within this time of
		the previous clear is refused until a reboot.

config OWNTECH_SAFETY_RUNTIME_SELFTEST
	bool "Class B self-tests at run time (ADR 0009)"
	default y
	depends on OWNTECH_SAFETY_SUPERVISION
	help
		CPU registers, RAM, flash CRC and clock checked in slices every
		10 ms by the system work queue. The start-up self-tests always run.
		Turn off only for development measurements.

config OWNTECH_SAFETY_FROZEN_PERIODS
	int "Control periods with an unchanged current reading before a sensor counts as frozen"
	default 2000
	range 100 100000
	depends on OWNTECH_SAFETY_SUPERVISION

config OWNTECH_SAFETY_TEST_HOOKS
	bool "Fault injection hooks for the safety L0 tests (never in an application)"
	default n
	depends on OWNTECH_SAFETY_SUPERVISION
```

## zephyr/modules/owntech_task_api/zephyr/Kconfig
```kconfig
config OWNTECH_TASK_API
	bool "Enable OwnTech scheduling"
	default y
	depends on OWNTECH_TIMER_DRIVER
	depends on OWNTECH_HRTIM_DRIVER

if OWNTECH_TASK_API

	config OWNTECH_TASK_ENABLE_ASYNCHRONOUS_TASKS
		bool "Enable support for asychronous tasks"
		help
			Asynchronous tasks are run in background when no synchronous task is running.
		default y

	config OWNTECH_TASK_MAX_ASYNCHRONOUS_TASKS
		int "Maximum number of asychronous tasks"
		help
			The higher this value, the more RAM will be reserved for tasks and unavailable to the main program.
		default 3
		range 1 5

	config OWNTECH_TASK_ASYNCHRONOUS_TASKS_STACK_SIZE
		int "Stack size for asynchronous threads"
		default 1024

	config OWNTECH_TASK_ENABLE_PERIODIC_TASKS
		bool "Enable support for a nested preemptible periodic real-time task"
		default n
		help
			A periodic task is an additional hard real-time task that runs
			less often than the critical task but remains a Zero-Latency
			Interrupt, meaning it can be preempted by the critical task
			without RTOS scheduling jitter. Enabling this reserves TIM7's
			IRQ vector (TIM7_DAC_IRQn) as a software-triggered interrupt
			line: TIM7 can no longer be used through the generic timer
			driver while this is on.

endif
```
