## zephyr/modules/owntech_safety_api/zephyr/Kconfig
```kconfig
config OWNTECH_SAFETY_API
	bool "Enable OwnTech safety measures to protect the board"
	default y
	depends on OWNTECH_SHIELD_API

config OWNTECH_SAFETY_SUPERVISION
	bool
	default y if OWNTECH_HRTIM_DRIVER
	help
		CPU supervision (ADR 0009): independent watchdog, fatal-error
		handler and HRTIM system fault. It has no prompt on purpose:
		user configuration cannot turn it off. It does not need a shield.

config OWNTECH_SAFETY_REPEAT_CLEAR_MS
	int "Time after a clear during which a new fault requires a reboot (ms)"
	default 10000
	range 100 600000
	depends on OWNTECH_SAFETY_SUPERVISION
	help
		ADR 0009 repeat-clear rule: a fault that comes within this time
		of a clear cannot be cleared with clearFault(), however long one
		waits: only a reboot (sys_reboot or the reset pin) or a power
		cycle lifts it. A watchdog reset does not. The time runs from the
		clear to the new fault.

config OWNTECH_SAFETY_RUNTIME_SELFTEST
	bool "Class B self-tests at run time (ADR 0009)"
	default y
	depends on OWNTECH_SAFETY_SUPERVISION
	help
		CPU registers, RAM, flash CRC and clock checked in slices every
		10 ms by the system work queue. The start-up self-tests always run.
		Can be turned off only in development mode (safety-mode =
		"development" in app.overlay): any other build fails.

config OWNTECH_SAFETY_KERNEL_TIMEOUT_US
	int "Longest time without the system work queue running before the watchdog resets the board (us)"
	default 20000
	range 15000 1000000
	depends on OWNTECH_SAFETY_SUPERVISION
	help
		ADR 0009: the control task runs at zero latency and keeps
		running when a thread spins with interrupts locked (irq_lock),
		which stops every thread: communication, the application's
		background tasks and the run-time self-tests. The run-time
		self-test work stamps a heartbeat every 10 ms (longest gap
		measured on the Spin under load: 11 ms); when the stamp is older
		than this, the control task latches a watchdog fault, stops the
		outputs and stops feeding the watchdog (reset). Set it from the
		application's process safety time (docs/safety/kernel_liveness.md)
		and above the longest gap measured on the target
		(safety_supervision_liveness()). Off without the run-time
		self-tests (development mode only).

config OWNTECH_SAFETY_FROZEN_PERIODS
	int "Control periods with an unchanged current reading before a sensor counts as frozen"
	default 2000
	range 100 100000
	depends on OWNTECH_SAFETY_SUPERVISION
	help
		Also the number of control periods a watched current sensor may
		give no reading at all while the PWM runs (data not dispatched)
		before the Safety API latches a self-test fault.

config OWNTECH_SAFETY_TEST_HOOKS
	bool "Fault injection hooks for the safety L0 tests (never in an application)"
	default n
	depends on OWNTECH_SAFETY_SUPERVISION

config OWNTECH_SAFETY_TIMING_PROBES
	bool "Cycle-counter probes in the control interrupt (timing tests only)"
	default n
	depends on OWNTECH_SAFETY_SUPERVISION
	help
		Times each block of the control interrupt (software check, data
		dispatch, user task, threshold read-back, plausibility, watchdog
		feed) and the HRTIM gate's interrupt-locked window into
		g_safety_timing (safety_timing.h). For the L0-TOV timing tests
		(issue #27); adds about 50 cycles per period. Never in a product.
```
