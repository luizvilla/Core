/*
 * Copyright (c) 2026-present LAAS-CNRS
 *
 *   This program is free software: you can redistribute it and/or modify
 *   it under the terms of the GNU Lesser General Public License as published by
 *   the Free Software Foundation, either version 2.1 of the License, or
 *   (at your option) any later version.
 *
 *   This program is distributed in the hope that it will be useful,
 *   but WITHOUT ANY WARRANTY; without even the implied warranty of
 *   MERCHANTABILITY or FITNESS FOR A PARTICULAR PURPOSE.  See the
 *   GNU Lesser General Public License for more details.
 *
 *   You should have received a copy of the GNU Lesser General Public License
 *   along with this program.  If not, see <https://www.gnu.org/licenses/>.
 *
 * SPDX-License-Identifier: LGPL-2.1
 */

/**
 * @file safety_states.c
 * @brief Safe states, safe outputs and the emergency stop (ADR 0009, #20).
 *
 * Safe state: each leg's two HRTIM outputs take a fault level on any trip
 * (open: both off; short-low / short-high: one switch on). The HRTIM fixes
 * these levels once the timer runs, so they are applied when the timer is
 * initialised (hrtim_safety_fault_levels(), called by the HRTIM driver), from
 * the devicetree or from safety_set_leg_safe_state() before that.
 *
 * Emergency stop (software-detected faults: fatal error, threshold changed
 * behind the API): disabling the outputs would put every leg in its idle
 * state, i.e. open, even a leg whose safe state is a short. When a comparator
 * trip is armed, the emergency stop instead writes its threshold to the
 * extreme, which raises a real hardware fault: every leg then takes its own
 * safe state through the HRTIM, as for any trip. Without an armed comparator,
 * the outputs are disabled.
 *
 * Safe outputs (relay, driver enables): driven to their safe level on any trip
 * and at boot while a fault is latched.
 */

#include <zephyr/kernel.h>
#include <zephyr/sys/printk.h>
#include <soc.h>
#include <stm32_ll_hrtim.h>

#include "hrtim.h"
#include "safety_supervision.h"
#include "safety_trips.h"
#include "safety_states.h"
#include "safety_protection_plan.h"   /* generated by protection_manifest.py */

struct leg_state {
	const char *name;
	uint8_t timer;   /* HRTIM timing unit: 0 = A ... 5 = F */
	uint8_t f1, f2;  /* fault level of OUT1 / OUT2: 2 inactive, 1 active */
	uint8_t low_out; /* output driving the low-side switch (pwm-x1-high) */
};

struct safe_output {
	const char *name;
	char port;
	uint8_t pin;
	uint8_t level;
};

#if SAFETY_LEGS > 0
static struct leg_state legs[] = { SAFETY_LEG_TABLE };
#endif
#if SAFETY_SAFE_OUTPUTS > 0
static const struct safe_output outputs[] = { SAFETY_SAFE_OUTPUT_TABLE };
#endif

static uint32_t ll_level(uint8_t f)
{
	return (f == 1U) ? LL_HRTIM_OUT_FAULTSTATE_ACTIVE : LL_HRTIM_OUT_FAULTSTATE_INACTIVE;
}

/* Strong override of the HRTIM driver's weak hook, called before the timer
 * counter is enabled: the fault level of the two outputs of timing unit tu. */
void hrtim_safety_fault_levels(hrtim_tu_number_t tu, uint32_t *out1, uint32_t *out2)
{
	*out1 = LL_HRTIM_OUT_FAULTSTATE_INACTIVE;
	*out2 = LL_HRTIM_OUT_FAULTSTATE_INACTIVE;
#if SAFETY_LEGS > 0
	for (size_t i = 0; i < ARRAY_SIZE(legs); i++) {
		if (legs[i].timer == (uint8_t)tu) {
			*out1 = ll_level(legs[i].f1);
			*out2 = ll_level(legs[i].f2);
		}
	}
#else
	ARG_UNUSED(tu);
#endif
}

int safety_set_leg_safe_state(int leg, safety_safe_state_t state)
{
#if SAFETY_LEGS > 0
	if (leg < 0 || leg >= (int)ARRAY_SIZE(legs)) {
		return -2;
	}
	struct leg_state *l = &legs[leg];
	uint32_t cen = HRTIM_MCR_TACEN << l->timer;
	if (safety_trips_armed() || (HRTIM1->sMasterRegs.MCR & cen)) {
		return -1;   /* the HRTIM fixes the fault levels once the timer runs */
	}
	bool out2_low = (l->low_out == 2U);
	switch (state) {
	case SAFETY_SAFE_OPEN:
		l->f1 = 2U;
		l->f2 = 2U;
		break;
	case SAFETY_SAFE_SHORT_LOW:
		l->f1 = out2_low ? 2U : 1U;
		l->f2 = out2_low ? 1U : 2U;
		break;
	case SAFETY_SAFE_SHORT_HIGH:
		l->f1 = out2_low ? 1U : 2U;
		l->f2 = out2_low ? 2U : 1U;
		break;
	default:
		return -2;
	}
	return 0;
#else
	ARG_UNUSED(leg);
	ARG_UNUSED(state);
	return -2;
#endif
}

static GPIO_TypeDef *gpio_port(char port)
{
	switch (port) {
	case 'A': return GPIOA;
	case 'B': return GPIOB;
	case 'C': return GPIOC;
	case 'D': return GPIOD;
	default: return NULL;
	}
}

void safety_outputs_safe(void)
{
#if SAFETY_SAFE_OUTPUTS > 0
	for (size_t i = 0; i < ARRAY_SIZE(outputs); i++) {
		GPIO_TypeDef *g = gpio_port(outputs[i].port);
		if (g == NULL) {
			continue;
		}
		RCC->AHB2ENR |= RCC_AHB2ENR_GPIOAEN << (outputs[i].port - 'A');
		g->BSRR = outputs[i].level ? (1U << outputs[i].pin) : (1U << (outputs[i].pin + 16U));
		g->MODER = (g->MODER & ~(3U << (2U * outputs[i].pin))) | (1U << (2U * outputs[i].pin));
	}
#endif
}

void safety_emergency_stop(void)
{
	if (safety_trips_force_fault() != 0) {
		safety_outputs_disable_all();
	}
	safety_outputs_safe();
}

int safety_safe_output_count(void)
{
	return SAFETY_SAFE_OUTPUTS;
}

int safety_leg_count(void)
{
	return SAFETY_LEGS;
}
